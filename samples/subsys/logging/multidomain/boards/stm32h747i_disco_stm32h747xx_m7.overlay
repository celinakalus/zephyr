/*
 * Copyright (c) 2024 Celina Sophie Kalus <hello@celinakalus.de>
 *
 * SPDX-License-Identifier: Apache-2.0
 */

/ {
	chosen {
		/delete-property/ zephyr,ipc_shm;
		zephyr,log_ipc = &ipc0;
	};

	ipc0: ipc0 {
		compatible = "zephyr,ipc-openamp-static-vrings";
		memory-region = <&sram4>;
		mboxes = <&mailbox 11>, <&mailbox 10>;
		mbox-names = "tx", "rx";
		role = "host";
		status = "okay";
	};
};

&mailbox {
	status = "okay";
};
