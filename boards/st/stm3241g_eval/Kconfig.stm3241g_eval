## boards/st/stm3241g_eval/Kconfig.stm3241g_eval
```kconfig
# Copyright (c) 2016 Open-RnD Sp. z o.o.
# SPDX-License-Identifier: Apache-2.0

config BOARD_STM3241G_EVAL
	select SOC_STM32F417XX
```

## boards/ti/cc1312r1_launchxl/Kconfig.cc1312r1_launchxl
```kconfig
# TI CC1312R LaunchXL board

# Copyright (c) 2019 Brett Witherspoon
# SPDX-License-Identifier: Apache-2.0

config BOARD_CC1312R1_LAUNCHXL
	select SOC_CC1312R
```

## samples/basic/blinky/boards/stm32h747i_disco_stm32h747xx_m4.conf
```kconfig
CONFIG_CONSOLE=y
CONFIG_UART_CONSOLE=y
CONFIG_PRINTK=y
CONFIG_MAIN_STACK_SIZE=4096
```

## samples/subsys/logging/multidomain/boards/stm32h747i_disco_stm32h747xx_m7.conf
```kconfig
CONFIG_LOG_BACKEND_UART_ASYNC=y
CONFIG_UART_ASYNC_API=y
CONFIG_UART_0_ASYNC=y

CONFIG_MBOX_STM32_HSEM=y
```
